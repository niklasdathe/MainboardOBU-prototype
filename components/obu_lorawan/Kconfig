## components/obu_lorawan/Kconfig
```kconfig
menu "BicycleOBU LoRaWAN uplink"

config OBU_LORAWAN_ENABLE
    bool "Enable Wio-SX1262 LoRaWAN uplink"
    default n
    help
        Enable the Seeed XIAO ESP32-S3 + Wio-SX1262 B2B radio as a
        best-effort LoRaWAN uplink for received raw C-ITS frames. The device
        sends binary fragments to a LoRaWAN network server; a server-side
        bridge reassembles them and publishes the original frame to
        OpenTrafficMap MQTT.

config OBU_LORAWAN_JOIN_EUI
    string "LoRaWAN JoinEUI (16 hex digits)"
    depends on OBU_LORAWAN_ENABLE
    default "0000000000000000"

config OBU_LORAWAN_DEV_EUI
    string "LoRaWAN DevEUI (16 hex digits)"
    depends on OBU_LORAWAN_ENABLE
    default ""

config OBU_LORAWAN_NWK_KEY
    string "LoRaWAN NwkKey (32 hex digits)"
    depends on OBU_LORAWAN_ENABLE
    default ""

config OBU_LORAWAN_APP_KEY
    string "LoRaWAN AppKey (32 hex digits)"
    depends on OBU_LORAWAN_ENABLE
    default ""

config OBU_LORAWAN_FPORT
    int "Raw-frame fragment FPort"
    depends on OBU_LORAWAN_ENABLE
    range 1 223
    default 10

config OBU_LORAWAN_MAX_FRAME_BYTES
    int "Maximum raw C-ITS frame forwarded over LoRaWAN"
    depends on OBU_LORAWAN_ENABLE
    range 64 512
    default 512
    help
        Larger 802.11p frames are dropped rather than truncated. OpenTrafficMap
        must receive the original frame bytes intact.

config OBU_LORAWAN_FRAGMENT_DATA_BYTES
    int "Raw bytes per LoRaWAN fragment"
    depends on OBU_LORAWAN_ENABLE
    range 8 32
    default 32
    help
        The BicycleOBU fragment header is 12 bytes. A 32-byte data fragment
        therefore creates a 44-byte LoRaWAN application payload, conservative
        enough for low EU868 data rates.

config OBU_LORAWAN_QUEUE_DEPTH
    int "Pending raw-frame queue depth"
    depends on OBU_LORAWAN_ENABLE
    range 1 8
    default 4

config OBU_LORAWAN_MIN_FRAGMENT_INTERVAL_MS
    int "Minimum delay between fragment uplinks (ms)"
    depends on OBU_LORAWAN_ENABLE
    range 1000 600000
    default 10000
    help
        This is an additional application-side throttle. RadioLib LoRaWAN duty
        cycle handling remains enabled and is the authoritative regulatory gate.

config OBU_LORAWAN_JOIN_RETRY_MS
    int "Delay between OTAA join retries (ms)"
    depends on OBU_LORAWAN_ENABLE
    range 5000 600000
    default 60000

endmenu
```

## components/obu_otm/Kconfig
```kconfig
menu "Parked direct S3 Wi-Fi OpenTrafficMap uploader"

config OBU_OTM_DIRECT_ENABLE
    bool "Enable direct OpenTrafficMap Wi-Fi uploader"
    default n
    select OBU_DNS_FALLBACK_ENABLE
    help
        Enable the parked development Wi-Fi/MQTT uplink to OpenTrafficMap.
        This component is excluded from normal S3 builds. Re-enable the
        component deliberately before using these options.

config OBU_WIFI_DEBUG
    bool "Enable Wi-Fi debug diagnostics"
    depends on OBU_OTM_DIRECT_ENABLE
    default n
    help
        Enable additional development diagnostics for the S3 Wi-Fi uplink.
        The firmware logs Wi-Fi driver/netif debug output, the effective STA
        configuration, association details, disconnect reason names and the
        DHCP/IP transition without printing the configured Wi-Fi password.

config OBU_DNS_FALLBACK_ENABLE
    bool
    default y
    help
        Internal guard for the direct OpenTrafficMap uploader fallback DNS.
        OBU_OTM_DIRECT_ENABLE selects this option so an existing generated
        sdkconfig cannot accidentally leave DNS fallback disabled.

config OBU_DNS_FALLBACK_IPV4
    string "Fallback DNS IPv4 address"
    depends on OBU_DNS_FALLBACK_ENABLE
    default "1.1.1.1"
    help
        IPv4 address used for ESP_NETIF_DNS_FALLBACK. DHCP continues to control
        the main and backup DNS servers; this address is used only as the
        fallback resolver when the network-provided resolver is unavailable.

config OBU_OTM_TLS_TRACE
    bool "Enable verbose OpenTrafficMap TLS handshake tracing"
    depends on OBU_OTM_DIRECT_ENABLE
    default n
    select MBEDTLS_DEBUG
    help
        Enable ESP-IDF/mbedTLS internal TLS handshake tracing while diagnosing
        OpenTrafficMap broker connection failures. This is noisy development
        instrumentation and should only be enabled explicitly for short
        diagnostic captures.

config OBU_WIFI_SSID
    string "Development Wi-Fi SSID"
    depends on OBU_OTM_DIRECT_ENABLE
    default ""

config OBU_WIFI_PASSWORD
    string "Development Wi-Fi password"
    depends on OBU_OTM_DIRECT_ENABLE
    default ""

config OBU_OTM_NODE_ID
    string "OpenTrafficMap node id"
    depends on OBU_OTM_DIRECT_ENABLE
    default "bicycleobu-prototype"

endmenu
```

## firmware/c5-tx/main/Kconfig.projbuild
```kconfig
menu "BicycleOBU C5 TX test transmitter"

config C5_TX_ENABLED
    bool "Enable V2X transmission"
    default y
    help
        Enables the standalone ESP32-C5 transmitter. This firmware is intended
        for controlled development and interoperability testing.

config C5_TX_FREQUENCY_MHZ
    int "ITS-G5 center frequency (MHz)"
    range 5860 5900
    default 5900
    help
        Center frequency passed to the existing ESP32-C5 802.11p radio driver.
        The driver accepts 10 MHz steps between 5860 and 5900 MHz.

config C5_TX_SOURCE_MAC
    string "802.11 source MAC"
    default "02:00:00:00:C5:01"

config C5_TX_STATION_ID
    int "ITS station ID"
    range 1 2147483647
    default 1001
    help
        StationId used by generated VAMs and, when enabled, patched into
        manually configured unsecured Facilities PDUs.

config C5_TX_GN_STATION_TYPE
    int "Station type (ETSI CDD StationType)"
    range 0 255
    default 2
    help
        StationType used by the generated VAM BasicContainer and the low five
        station-type bits carried by this prototype's GeoNetworking address.
        Value 2 represents a cyclist.

config C5_TX_POSITION_ACCURATE
    bool "Set GeoNetworking position accuracy indicator"
    default n

config C5_TX_LATITUDE_1E7
    int "Source latitude (1e-7 degree)"
    range -900000000 900000000
    default 0
    help
        Used both in the GeoNetworking source position vector and generated
        VAM ReferencePosition.

config C5_TX_LONGITUDE_1E7
    int "Source longitude (1e-7 degree)"
    range -1799999999 1800000000
    default 0
    help
        Used both in the GeoNetworking source position vector and generated
        VAM ReferencePosition. The CDD-reserved value -180 degrees is excluded.

config C5_TX_SPEED_CM_S
    int "Source speed (cm/s)"
    range 0 16383
    default 0
    help
        Used both in the GeoNetworking source position vector and generated
        VAM SpeedValue. 16383 means unavailable in the CDD.

config C5_TX_HEADING_DEG10
    int "Source heading (0.1 degree)"
    range 0 3599
    default 0
    help
        Used both in the GeoNetworking source position vector and generated
        VAM Wgs84Angle. The CDD value 3600 is explicitly prohibited.

config C5_TX_UNIX_TIME_AT_BOOT
    int "UTC Unix time at boot for time-valid tests (0 = diagnostic uptime)"
    range 0 2147483647
    default 0
    help
        Set this to the expected UTC Unix time in seconds at power-on. The
        firmware converts it to elapsed ITS/TAI milliseconds since 2004-01-01
        and uses it for GeoNetworking timestamps and VAM generationDeltaTime.
        If zero, uptime is used and the run is not time-conformance evidence.

config C5_TX_ITS_LEAP_SECONDS_SINCE_EPOCH
    int "Leap seconds since the ITS epoch"
    range 0 63
    default 5
    help
        Number of positive leap seconds introduced since 2004-01-01 UTC.
        Five covers 2005, 2008, 2012, 2015 and 2016. Update this if a later
        leap second is introduced before the test date.

config C5_TX_PATCH_STATION_ID
    bool "Patch StationID in manually configured unsecured Facilities PDUs"
    default y

config C5_TX_PATCH_GENERATION_DELTA_TIME
    bool "Patch generationDeltaTime for manual CAM/VAM PDUs when UTC base is configured"
    default y
    help
        Applies only to manually supplied CAM/VAM UPER PDUs. Generated VAMs
        encode stationId and generationDeltaTime directly from current config.

config C5_TX_ALLOW_HEADER_ONLY_PROBES
    bool "Allow header-only diagnostic probes (NON-CONFORMANT)"
    default n
    help
        When a non-generated profile has no configured UPER PDU, generate only
        ItsPduHeader. Useful for classifier tests, but not a valid Facilities
        message and never suitable as conformance evidence.

config C5_TX_BUTTON_TRIGGER
    bool "Send configured button profiles when BOOT is pressed"
    default y

config C5_TX_BOOT_GPIO
    int "BOOT button GPIO"
    range 0 31
    default 28
    help
        Seeed Studio XIAO ESP32-C5 BOOT button is GPIO28 and active low.

config C5_TX_LED_GPIO
    int "User LED GPIO"
    range 0 31
    default 27
    help
        Seeed Studio XIAO ESP32-C5 user LED is GPIO27 and active low.

config C5_TX_PERIODIC_ENABLE
    bool "Enable periodic profile scheduling"
    default n
    help
        Global gate for periodic transmission. Individual profiles also have a
        periodic enable and interval.

config C5_TX_STARTUP_TRIGGER
    bool "Send button-enabled profiles once after startup"
    default n

config C5_TX_INTERFRAME_GAP_MS
    int "Gap between profiles in a button/startup burst (ms)"
    range 10 5000
    default 100

config C5_TX_GBC_DISTANCE_A_M
    int "DENM GeoBroadcast distance A (m)"
    range 1 65535
    default 500

config C5_TX_GBC_DISTANCE_B_M
    int "DENM GeoBroadcast distance B (m)"
    range 1 65535
    default 500

config C5_TX_GBC_ANGLE_DEG10
    int "DENM GeoBroadcast angle (0.1 degree)"
    range 0 3600
    default 0

config C5_TX_GBC_SHAPE
    int "DENM GeoBroadcast shape subtype (0 circle, 1 rectangle, 2 ellipse)"
    range 0 2
    default 0

menu "CAM profile"
config C5_TX_CAM_ENABLE
    bool "Enable CAM profile"
    default y
config C5_TX_CAM_BUTTON
    bool "Send CAM on BOOT trigger"
    default y
config C5_TX_CAM_PERIODIC
    bool "Schedule CAM periodically"
    default y
config C5_TX_CAM_INTERVAL_MS
    int "CAM interval (ms)"
    range 100 3600000
    default 1000
config C5_TX_CAM_PDU_HEX
    string "CAM Facilities UPER PDU (hex, empty = disabled unless probe mode)"
    default ""
endmenu

menu "VAM profile"
config C5_TX_VAM_ENABLE
    bool "Enable VAM profile"
    default y
config C5_TX_VAM_BUTTON
    bool "Send VAM on BOOT trigger"
    default y
config C5_TX_VAM_PERIODIC
    bool "Schedule VAM periodically"
    default y
config C5_TX_VAM_INTERVAL_MS
    int "VAM interval (ms)"
    range 100 3600000
    default 1000

choice C5_TX_VAM_PDU_SOURCE
    prompt "VAM Facilities PDU source"
    default C5_TX_VAM_GENERATED
config C5_TX_VAM_GENERATED
    bool "Generate a minimal ETSI VAM from menuconfig fields"
    help
        Generates a UPER VAM with protocolVersion 3, MessageId 16,
        BasicContainer and VruHighFrequencyContainer. Global station ID,
        station type, position, speed and heading fields are reused so the
        Facilities and GeoNetworking data describe the same test state.
config C5_TX_VAM_MANUAL_PDU
    bool "Use manually supplied complete VAM UPER hex"
endchoice

config C5_TX_VAM_PDU_HEX
    string "Manual VAM Facilities UPER PDU (hex)"
    default ""
    depends on C5_TX_VAM_MANUAL_PDU

config C5_TX_VAM_POSITION_SEMI_MAJOR_CONFIDENCE_CM
    int "Position semi-major confidence (cm; 4095 = unavailable)"
    range 0 4095
    default 4095

config C5_TX_VAM_POSITION_SEMI_MINOR_CONFIDENCE_CM
    int "Position semi-minor confidence (cm; 4095 = unavailable)"
    range 0 4095
    default 4095

config C5_TX_VAM_POSITION_SEMI_MAJOR_ORIENTATION_DEG10
    int "Position confidence ellipse orientation (0.1 degree; 3601 = unavailable)"
    range 0 3601
    default 3601
    help
        CDD value 3600 is prohibited and will be rejected at runtime.

config C5_TX_VAM_ALTITUDE_CM
    int "Altitude above reference ellipsoid (cm; 800001 = unavailable)"
    range -100000 800001
    default 800001

config C5_TX_VAM_ALTITUDE_CONFIDENCE
    int "Altitude confidence enum (0..15; 15 = unavailable)"
    range 0 15
    default 15

config C5_TX_VAM_HEADING_CONFIDENCE_DEG10
    int "Heading confidence (0.1 degree; 127 = unavailable)"
    range 1 127
    default 127

config C5_TX_VAM_SPEED_CONFIDENCE_CM_S
    int "Speed confidence (cm/s; 127 = unavailable)"
    range 1 127
    default 127

config C5_TX_VAM_LONGITUDINAL_ACCELERATION_DM_S2
    int "Longitudinal acceleration (0.1 m/s^2; 161 = unavailable)"
    range -160 161
    default 0

config C5_TX_VAM_LONGITUDINAL_ACCELERATION_CONFIDENCE_DM_S2
    int "Longitudinal acceleration confidence (0.1 m/s^2; 102 = unavailable)"
    range 0 102
    default 102
endmenu

menu "DENM profile"
config C5_TX_DENM_ENABLE
    bool "Enable DENM profile"
    default y
config C5_TX_DENM_BUTTON
    bool "Send DENM on BOOT trigger"
    default y
config C5_TX_DENM_PERIODIC
    bool "Schedule DENM periodically"
    default n
config C5_TX_DENM_INTERVAL_MS
    int "DENM replay interval (ms)"
    range 100 3600000
    default 5000
config C5_TX_DENM_PDU_HEX
    string "DENM Facilities UPER PDU (hex, empty = disabled unless probe mode)"
    default ""
endmenu

menu "CPM profile"
config C5_TX_CPM_ENABLE
    bool "Enable CPM profile"
    default y
config C5_TX_CPM_BUTTON
    bool "Send CPM on BOOT trigger"
    default n
config C5_TX_CPM_PERIODIC
    bool "Schedule CPM periodically"
    default n
config C5_TX_CPM_INTERVAL_MS
    int "CPM interval (ms)"
    range 100 3600000
    default 1000
config C5_TX_CPM_PDU_HEX
    string "CPM Facilities UPER PDU (hex, empty = disabled unless probe mode)"
    default ""
endmenu

menu "SPATEM profile"
config C5_TX_SPATEM_ENABLE
    bool "Enable SPATEM profile"
    default y
config C5_TX_SPATEM_BUTTON
    bool "Send SPATEM on BOOT trigger"
    default n
config C5_TX_SPATEM_PERIODIC
    bool "Schedule SPATEM periodically"
    default n
config C5_TX_SPATEM_INTERVAL_MS
    int "SPATEM interval (ms)"
    range 100 3600000
    default 1000
config C5_TX_SPATEM_PDU_HEX
    string "SPATEM Facilities UPER PDU (hex, empty = disabled unless probe mode)"
    default ""
endmenu

menu "MAPEM profile"
config C5_TX_MAPEM_ENABLE
    bool "Enable MAPEM profile"
    default y
config C5_TX_MAPEM_BUTTON
    bool "Send MAPEM on BOOT trigger"
    default n
config C5_TX_MAPEM_PERIODIC
    bool "Schedule MAPEM periodically"
    default n
config C5_TX_MAPEM_INTERVAL_MS
    int "MAPEM interval (ms)"
    range 100 3600000
    default 1000
config C5_TX_MAPEM_PDU_HEX
    string "MAPEM Facilities UPER PDU (hex, empty = disabled unless probe mode)"
    default ""
endmenu

menu "IVIM profile"
config C5_TX_IVIM_ENABLE
    bool "Enable IVIM profile"
    default y
config C5_TX_IVIM_BUTTON
    bool "Send IVIM on BOOT trigger"
    default n
config C5_TX_IVIM_PERIODIC
    bool "Schedule IVIM periodically"
    default n
config C5_TX_IVIM_INTERVAL_MS
    int "IVIM interval (ms)"
    range 100 3600000
    default 5000
config C5_TX_IVIM_PDU_HEX
    string "IVIM Facilities UPER PDU (hex, empty = disabled unless probe mode)"
    default ""
endmenu

endmenu
```
