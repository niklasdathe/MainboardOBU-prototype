## firmware/s3/main/Kconfig.projbuild
```kconfig
menu "BicycleOBU prototype"

config OBU_GNSS_PPS_GPIO
    int "GNSS PPS GPIO"
    range 0 48
    default 47
    help
        GPIO carrying the L76K PPS pulse. The Wio-SX1262 B2B connector owns
        GPIO41 as SX1262 NSS on the LoRaWAN prototype, so the L76K PPS carrier
        must be rewired to GPIO47. Override only for a hardware profile without
        the Wio-SX1262 attached.

menu "Local warning and V2X diagnostics"

config OBU_BUZZER_ENABLE
    bool "Enable Expansion Base local warning buzzer"
    default y
    help
        Enable the passive buzzer on the XIAO Expansion Base A3/D3 pin as a
        local warning output. The output is independent of the phone and OLED.

config OBU_BUZZER_DEFAULT_MUTED
    bool "Start local warning buzzer muted"
    depends on OBU_BUZZER_ENABLE
    default n
    help
        Start with audible warning output muted. Runtime control can later
        change this state through the authenticated control-plane interface.

config OBU_BUZZER_FREQUENCY_HZ
    int "Warning buzzer frequency (Hz)"
    depends on OBU_BUZZER_ENABLE
    range 100 10000
    default 2200

config OBU_BUZZER_DURATION_MS
    int "Warning buzzer pulse duration (ms)"
    depends on OBU_BUZZER_ENABLE
    range 20 1000
    default 120

config OBU_GEIGER_COUNTER_ENABLE
    bool "Enable V2X Geiger counter mode"
    depends on OBU_BUZZER_ENABLE
    default n
    help
        Emit a short best-effort buzzer tick for each received ETSI
        GeoNetworking V2X packet. Diagnostic ticks never block the receive path
        and may be dropped under heavy traffic so warning audio keeps priority.

config OBU_GEIGER_COUNTER_FREQUENCY_HZ
    int "V2X Geiger counter frequency (Hz)"
    depends on OBU_GEIGER_COUNTER_ENABLE
    range 100 10000
    default 3200

config OBU_GEIGER_COUNTER_DURATION_MS
    int "V2X Geiger counter pulse duration (ms)"
    depends on OBU_GEIGER_COUNTER_ENABLE
    range 10 200
    default 25

endmenu

menu "LoRaWAN uplink"

config OBU_LORAWAN_ENABLE
    bool "Enable Wio-SX1262 LoRaWAN uplink"
    default n
    help
        Enable the Seeed XIAO ESP32-S3 + Wio-SX1262 B2B radio as a
        best-effort LoRaWAN uplink for received raw C-ITS frames. The device
        sends binary fragments to a LoRaWAN network server; a server-side
        bridge reassembles them and publishes the original frame to
        OpenTrafficMap MQTT.

menu "Activation and network"
    depends on OBU_LORAWAN_ENABLE

config OBU_LORAWAN_JOIN_EUI
    string "JoinEUI (16 hex digits)"
    default "0000000000000000"

config OBU_LORAWAN_DEV_EUI
    string "DevEUI (16 hex digits)"
    default ""

config OBU_LORAWAN_NWK_KEY
    string "NwkKey (32 hex digits)"
    default ""

config OBU_LORAWAN_APP_KEY
    string "AppKey (32 hex digits)"
    default ""

config OBU_LORAWAN_JOIN_DATARATE
    int "Initial OTAA JoinRequest data rate (EU868 DR0..DR5)"
    range 0 5
    default 3
    help
        Select the data rate used only for JoinRequest uplinks before an OTAA
        session exists. EU868 mapping is DR0=SF12, DR1=SF11, DR2=SF10,
        DR3=SF9, DR4=SF8 and DR5=SF7, all at 125 kHz. DR3 is retained as a
        coverage-balanced join default. The application uplink rate is
        configured separately below.

config OBU_LORAWAN_ADR_ENABLE
    bool "Enable ADR for application uplinks"
    default n
    help
        Let the LoRaWAN network control application uplink data rate and TX
        power. Disable this for deterministic throughput testing on the bicycle.
        With ADR disabled, the fixed application data rate below is applied
        after both new and restored OTAA sessions.

config OBU_LORAWAN_UPLINK_DATARATE
    int "Fixed application uplink data rate (EU868 DR0..DR5)"
    depends on !OBU_LORAWAN_ADR_ENABLE
    range 0 5
    default 5
    help
        Fixed data rate used for application uplinks when ADR is disabled.
        DR5 = SF7/BW125 and is the fastest data rate supported by every uplink
        channel in the current TTS EU868 channel plan, so it is the default for
        maximum-throughput evaluation. Lower this only when link margin is
        insufficient.

endmenu

menu "Payload and buffering"
    depends on OBU_LORAWAN_ENABLE

config OBU_LORAWAN_FPORT
    int "Raw-frame fragment FPort"
    range 1 223
    default 10

config OBU_LORAWAN_MAX_FRAME_BYTES
    int "Maximum raw C-ITS frame forwarded"
    range 64 512
    default 512
    help
        Larger 802.11p frames are dropped rather than truncated. OpenTrafficMap
        must receive the original frame bytes intact.

config OBU_LORAWAN_FRAGMENT_DATA_BYTES
    int "Maximum raw bytes per LoRaWAN fragment"
    range 8 230
    default 230
    help
        Upper bound for raw C-ITS bytes placed in one LoRaWAN application
        fragment. The BicycleOBU fragment header is 12 bytes. At EU868 DR5,
        RadioLib permits a 242-byte application payload, so 230 raw bytes plus
        the 12-byte header fills the packet. At lower data rates the firmware
        automatically clamps this value to RadioLib getMaxPayloadLen() so the
        fragment remains legal for the active MAC/data-rate state.

config OBU_LORAWAN_QUEUE_DEPTH
    int "Pending raw-frame queue depth"
    range 1 8
    default 4

endmenu

menu "Airtime and retry scheduling"
    depends on OBU_LORAWAN_ENABLE

config OBU_LORAWAN_MIN_FRAGMENT_INTERVAL_MS
    int "Additional delay between fragment uplinks (ms)"
    range 0 600000
    default 0
    help
        Optional application-side throttle in addition to LoRaWAN timing. The
        maximum-throughput default is zero. RadioLib duty-cycle handling remains
        enabled and is always the authoritative regulatory gate.

config OBU_LORAWAN_JOIN_RETRY_MS
    int "Delay after an actual OTAA failure (ms)"
    range 5000 600000
    default 60000
    help
        Delay after an OTAA exchange fails. Duty-cycle restrictions are handled
        separately using RadioLib timeUntilUplink() and are not counted as join
        failures.

endmenu

menu "Diagnostics"
    depends on OBU_LORAWAN_ENABLE

config OBU_LORAWAN_DEBUG
    bool "Enable structured LoRaWAN ESP_LOG diagnostics"
    default n
    help
        Add structured radio/join diagnostics through ESP_LOG, including radio
        control-line state, join duration, RadioLib status names, timing and
        persistence state. Root keys are never printed.

config OBU_LORAWAN_RADIOLIB_PROTOCOL_DEBUG
    bool "Enable RadioLib basic + protocol trace (RLB_DBG/RLB_PRO)"
    depends on OBU_LORAWAN_DEBUG
    default y
    help
        Compile RadioLib with RADIOLIB_DEBUG_BASIC and
        RADIOLIB_DEBUG_PROTOCOL. This is the trace requested by RadioLib
        maintainers for LoRaWAN receive-window failures. It is verbose and may
        expose protocol identifiers/raw frames; review logs before sharing.

config OBU_LORAWAN_RADIOLIB_SPI_DEBUG
    bool "Enable RadioLib full SPI trace (RLB_SPI, extremely verbose)"
    depends on OBU_LORAWAN_DEBUG
    default n
    help
        Compile RadioLib with RADIOLIB_DEBUG_SPI. Enable only for a short
        diagnostic capture when protocol tracing is insufficient; the output is
        extremely large and can perturb timing if left enabled unnecessarily.

endmenu

endmenu

endmenu
```
